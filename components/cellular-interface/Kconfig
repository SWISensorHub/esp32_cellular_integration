## components/cellular-interface/Kconfig
```kconfig
menu "Cellular Interface"

    choice CELLULAR_MODULE
        prompt "Cellular implementation"

        config CELLULAR_MODULE_HL7802
            bool "Sierra Wireless HL7802"

        config CELLULAR_MODULE_BG96
            bool "Quectel BG96"

        config CELLULAR_MODULE_SARA_R4
            bool "u-blox SARA-R4"
    endchoice

endmenu
```

## sdkconfig.defaults
```kconfig
# Choose the Sierra Wireless HL7802 as the cellular_interface modem implementation
CONFIG_CELLULAR_MODULE_HL7802=y
```
